// DT overlay for CPU frequency operating points to 1.4GHz at a maximum CPU voltage of 1.4v

/dts-v1/;
/plugin/;

/ {
	fragment@0 {
		target = <&cpu0_opp_table>;

		__overlay__ {
			compatible = "operating-points-v2";
			opp-shared;

			// in order to match the H5 DT cooling-maps, update the existing OP table in-place
			// with the new voltages

			opp@1344000000 {
				opp-hz = /bits/ 64 <1368000000>;
				opp-microvolt = <1400000 1400000 1400000>;
				clock-latency-ns = <244144>; /* 8 32k periods */
			};

			opp@1368000000 {
				opp-hz = /bits/ 64 <1400000000>;
				opp-microvolt = <1400000 1400000 1400000>;
				clock-latency-ns = <244144>; /* 8 32k periods */
			};
		};
	};
};

