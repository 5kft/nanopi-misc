/dts-v1/;
/plugin/;

/ {
	// disable the pre-existing sun6i-rtc (at rtc/rtc0)
	fragment@0 {
		target = <&rtc>;

		__overlay__ {
			compatible = "not-compatible";
		};
	};

	// enable i2c0 for the H5
	fragment@1 {
		target-path = "/aliases";

		__overlay__ {
			i2c0 = "/soc/i2c@1c2ac00";
		};
	};

	// add the DS3231 RTC at 0x68 on i2c0
	fragment@2 {
		compatible = "allwinner,sun50i-h5";

		target = <&i2c0>;

		__overlay__ {
			#address-cells = <1>;
			#size-cells = <0>;
			status = "okay";

			ds3231: ds3231@68 {
				compatible = "maxim,ds3231";
				reg = <0x68>;
				status = "okay";
			};
		};
	};

	__overrides__ {
		ds3231 = <&ds3231>,"status";
	};
};

